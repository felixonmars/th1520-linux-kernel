## Documentation/devicetree/bindings/pinctrl/thead,th1520-pinctrl.yaml
```yaml
# SPDX-License-Identifier: (GPL-2.0-only OR BSD-2-Clause)
%YAML 1.2
---
$id: http://devicetree.org/schemas/pinctrl/thead,th1520-pinctrl.yaml#
$schema: http://devicetree.org/meta-schemas/core.yaml#

title: T-Head TH1520 SoC pin controller

maintainers:
  - Emil Renner Berthing <emil.renner.berthing@canonical.com>

description:
  Pinmux and pinconf controller in the T-Head TH1520 RISC-V SoC.

properties:
  compatible:
    enum:
      - thead,th1520-group1-pinctrl
      - thead,th1520-group2-pinctrl
      - thead,th1520-group3-pinctrl

  reg:
    maxItems: 1

patternProperties:
  '-[0-9]+$':
    type: object
    patternProperties:
      '-pins$':
        type: object
        $ref: /schemas/pinctrl/pincfg-node.yaml
        description:
          A pinctrl node should contain at least one subnode describing one
          or more pads and their associated pinmux and pinconf settings.

        properties:
          pins:
            $ref: /schemas/types.yaml#/definitions/string-array
            description: List of pads that properties in the node apply to.

          function:
            $ref: /schemas/types.yaml#/definitions/string
            enum: [ "0", "1", "2", "3", "4", "5" ]
            description: The mux function to select for the given pins.

          bias-disable: true

          bias-pull-up:
            type: boolean

          bias-pull-down:
            type: boolean

          drive-strength:
            enum: [ 1, 2, 3, 5, 7, 8, 10, 12, 13, 15, 16, 18, 20, 21, 23, 25 ]

          input-enable: true

          input-disable: true

          input-schmitt-enable: true

          input-schmitt-disable: true

          slew-rate:
            maximum: 1

          thead,strong-pull-up:
            oneOf:
              - type: boolean
              - $ref: /schemas/types.yaml#/definitions/uint32
                enum: [ 0, 2100 ]
            description: Enable or disable strong 2.1kOhm pull-up.

        required:
          - pins

        additionalProperties: false

    additionalProperties: false

required:
  - compatible
  - reg

additionalProperties: false

examples:
  - |
    padctrl0_apsys: pinctrl@ec007000 {
        compatible = "thead,th1520-group3-pinctrl";
        reg = <0xec007000 0x1000>;

        uart0_pins: uart0-0 {
            tx-pins {
                pins = "UART0_TXD";
                function = "0";
                bias-disable;
                drive-strength = <3>;
                input-disable;
                input-schmitt-disable;
                slew-rate = <0>;
            };

            rx-pins {
                pins = "UART0_RXD";
                function = "0";
                bias-disable;
                drive-strength = <1>;
                input-enable;
                input-schmitt-enable;
                slew-rate = <0>;
            };
        };
    };

    padctrl1_apsys: pinctrl@e7f3c000 {
        compatible = "thead,th1520-group2-pinctrl";
        reg = <0xe7f3c000 0x1000>;

        i2c5_pins: i2c5-0 {
            i2c-pins {
                pins = "QSPI1_CSN0",    /* I2C5_SCL */
                       "QSPI1_D0_MOSI"; /* I2C5_SDA */
                function = "2";
                bias-disable;
                drive-strength = <7>;
                input-enable;
                input-schmitt-enable;
                slew-rate = <0>;
                thead,strong-pull-up;
            };
        };
    };
```
